## config/boards/shields/snacky/Kconfig.defconfig
```kconfig
if SHIELD_SNACKY_LEFT

config ZMK_KEYBOARD_NAME
    default "Snacky"

config ZMK_SPLIT_ROLE_CENTRAL
    default y

endif

if SHIELD_SNACKY_LEFT || SHIELD_SNACKY_RIGHT

config ZMK_SPLIT
    default y

endif

if SHIELD_SNACKY_RIGHT

config ZMK_KEYBOARD_NAME
    default "Snacky"

endif
```

## config/boards/shields/snacky/kconfig.shield
```kconfig
config SHIELD_SNACKY_LEFT
    def_bool $(shields_list_contains,snacky_left)

config SHIELD_SNACKY_RIGHT
    def_bool $(shields_list_contains,snacky_right)
```
